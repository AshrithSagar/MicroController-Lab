; Roll “SPICE” continuously (a) left side (b) right side.

; 8050H:
; 37 60 93 97 00 00 D6

; 8000H:
START:
	SETB PSW.5 				; D2 D5 	; LOAD FROM EXTERNAL DATA MEMORY
	MOV DPTR, #8050H 		; 90 80 50 	; STARTING LOCATION OF THE LOOK-UP TABLE
	LCALL OUTPUT 			; 12 02 55 	; OUTPUT UTILITY ROUTINE
	LCALL DELAY 			; 12 _A0 00	; AWAIT

	MOV DPTR, #8050H 		; 90 80 50 	; STARTING LOCATION OF THE LOOK-UP TABLE
	MOVX A, @DPTR 			; E0 		; GET STARTING DATA, FOR LEFT ROTATE CASE
	MOV B, A 				; F5 F0 	; SAVE IN REG (B)

	MOV R0, #07H 			; 78 07 	; REPEAT FOR 7 BYTES

MODIFY:
	INC DPTR 				; A3 		; GO TO NEXT LOCATION
	MOVX A, @DPTR 			; E0 		; GET DATA FROM NEXT LOCATION

	; DECREMENT DATA POINTER AND GO TO CURRENT LOCATION
	MOV A, 82H 				; E5 82  	; GET (DPL)
	ADD A, #01H 			; 24 01 	; INCREMENT (DPL)
	MOV 82H, A 				; F5 82 	; SAVE (DPL)

	MOV A, 83H 				; E5 83 	; GET (DPH)
	ADDC A, #00H 			; 34 00 	; ADD CARRY TO (DPH)
	MOV 83H, A 				; F5 83 	; SAVE (DPH)

 	MOVX @DPTR, A 			; F0 		; COPY DATA TO CURRENT LOCATION

 	INC DPTR 				; A3 		; UPDATE TO NEXT LOCATION
	DJNZ R0, MODIFY 		; D8 _EE 	; REPEAT FOR ALL IN THE LOOK-UP TABLE

	MOV DPTR, #8050H 		; 90 80 56 	; LAST LOCATION OF THE LOOK-UP TABLE
	MOV A, B 				; GET STORED FIRST LOCATION DATA
	MOVX @DPTR, A 			; STORE FIRST DATA IN LAST LOCATION

	LJMP START 				; 02 00 00 	; REPEAT IN A LOOP

; A000H:
DELAY:
	; AWAIT (10H*0FAH*0FAH) MACHINE CYCLES => 1 SECOND
	MOV R3, #10H 			; 7B 10
	UP1:
		MOV R4, #0FAH 		; 7C FA
		UP2:
			MOV R5, #0FAH 	; 7D FA
		DJNZ R4, UP2 		; DC FC
	DJNZ R3, UP1 			; DB F8
	RET 					; 22 		; RETURN BACK TO THE MAIN LOOP

OUTPUT:
	RET
